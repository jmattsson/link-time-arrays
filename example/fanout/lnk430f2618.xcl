// Minimal linker file for MSP430F2618
-cmsp430

-Z(DATA)DATA16_I,DATA16_Z,DATA16_N=1100-30FF
-Z(DATA)CODE_I
-Z(DATA)CSTACK+_STACK_SIZE#

-Z(CONST)INFO=1000-10FF
-Z(CONST)INFOA=10C0-10FF
-Z(CONST)INFOB=1080-10BF
-Z(CONST)INFOC=1040-107F
-Z(CONST)INFOD=1000-103F

-Z(CONST)DATA16_C,DATA16_ID,DIFUNCT=3100-FFBF
-Z(CONST)DATA20_C,DATA20_ID=3100-FFBF,10000-1FFFF

-Z(CODE)CODE_ID
-Z(CODE)CSTART,ISR_CODE=3100-FFBF
-Z(CODE)INTVEC=FFC0-FFFF
-Z(CODE)RESET=FFFE-FFFF
-P(CODE)CODE=3100-FFBF,10000-1FFFF
